## conf/machine/sama5d27-jupiter-nano-sd.conf
```bitbake
#@TYPE: Machine
#@Name: Starcat SAMA5D27 Jupiter Nano
#@DESCRIPTION: Machine configuration for Jupiter Nano board

require include/sama5d2.inc

MACHINE_FEATURES = "apm alsa ext2 ext3 usbhost usbgadget touchscreen"
KERNEL_DEVICETREE = " \
		at91-sama5d27_jupiter_nano.dtb \
		"

do_image_wic[depends] += "u-boot-at91:do_deploy"
IMAGE_FSTYPES += " tar.gz wic"
WKS_FILE = "sdimage-bootpart.wks"

IMAGE_BOOT_FILES = "BOOT.BIN u-boot.bin uboot.env sama5d27_jupiter_nano.itb \
                    "

UBOOT_MACHINE ?= "sama5d27_jupiter_nano_mmc1_defconfig"
UBOOT_ENTRYPOINT = "0x20008000"
UBOOT_LOADADDRESS = "0x20008000"
UBOOT_ENV_SIZE = "0x4000"

AT91BOOTSTRAP_MACHINE ?= "sama5d27_jupiter_nano"

# Needed for FIT
MACHINE_ESSENTIAL_EXTRA_RDEPENDS = " dt-overlay-at91"
```
